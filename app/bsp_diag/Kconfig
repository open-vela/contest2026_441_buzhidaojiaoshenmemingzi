## app/bsp_diag/Kconfig
```kconfig
menu "Contest 2026 team 441 BK7258 BSP diagnostics"

config CONTEST2026_441_BSP_APCTL
	bool "AP/RPTUN/SMP status command"
	default n
	depends on BK7258_AP_CONTROL && SYSTEM_NSH
	select BUILTIN
	select NSH_BUILTIN_APPS
	help
		Build the apctl command used to inspect CPU0-to-AP startup,
		RPTUN state, physical CPU2 and AP SMP status.  The command is a
		diagnostic front end; the driver state remains in the BK7258 BSP.

config CONTEST2026_441_BSP_WIFI
	bool "Wi-Fi VNET diagnostic command"
	default n
	depends on BK7258_WIFI_VNET && !BK7258_AP_CORE && SYSTEM_NSH
	select BUILTIN
	select NSH_BUILTIN_APPS
	select SCHED_WAITPID
	help
		Build the bkwifi command for scan, association, DHCP/status and
		bounded network tests through the AP-owned Wi-Fi VNET service.
		Credentials are entered at runtime and are never compiled in.

endmenu
```

## app/vision_badge/Kconfig
```kconfig
config LVX_USE_DEMO_CONTEST2026_441_VISION_BADGE
	bool "Contest 2026 team 441 vision assistance badge"
	default n
	depends on BK7258_AP_CORE
	select BUILTIN
	select CRYPTO_MBEDTLS
	select NETUTILS_CJSON
	select NETUTILS_WEBCLIENT
	---help---
		Enable the BK7258 R1 vision assistance badge application. The camera
		backend captures one JPEG frame and the vision backend can send it to
		MiMo when a key is present on the mounted SD-NAND volume.

if LVX_USE_DEMO_CONTEST2026_441_VISION_BADGE

config CONTEST2026_441_XIAOZHI
	bool "Xiaozhi fallback conversation (not built with Agora)"
	default n
	depends on !CONTEST2026_441_AGORA
	select LIB_OPUS
	select OPENSSL_MBEDTLS_WRAPPER
	select NET_TCPPROTO_OPTIONS
	select NETUTILS_LIBWEBSOCKETS
	help
		Keep the fallback source available without putting two voice stacks
		in the fixed AP flash partition. Enable only for a Xiaozhi candidate.

config CONTEST2026_441_AGORA
	bool "Agora RTC on NuttX (pinned BK7258 SDK)"
	default n
	depends on BK7258_PSRAM && NET_UDP && !DISABLE_PTHREAD
	select BK7258_AGORA_RTC
	help
		Use the vendor RTC archive and portable AOSL sources with the team's
		NuttX platform layer. No automatic recording or cloud agent startup.
		RTC membership and actual voice quality require separate board tests.

config CONTEST2026_441_VISION_BADGE_STACKSIZE
	int "Vision badge main task stack size"
	default 8192

config CONTEST2026_441_WAKE_ASR
	bool "Computer-assisted local streaming ASR wake backend (candidate)"
	default n
	depends on CONTEST2026_441_AGORA && CONTEST2026_441_POWER && BK7258_AUD
	help
		Requires an explicitly started sherpa-onnx LAN host and its device key.
		500ms PCM chunks stay in RAM. Host text matching is not standalone
		on-board KWS. Enable CONTEST2026_441_WAKE to expose the wake commands.

config CONTEST2026_441_WAKE_STREAM
	bool "Persistent NuttX CONNECT PCM stream for LAN ASR (candidate)"
	default n
	depends on CONTEST2026_441_WAKE_ASR && !CONTEST2026_441_WAKE_UDP
	select NET_TCPPROTO_OPTIONS
	help
		Reuse the existing webclient tunnel and one authenticated TCP socket.
		Send ordered 20ms PCM frames, retaining bounded queues and result age.
		The companion host is an audio endpoint, not a forwarding proxy.

config CONTEST2026_441_WAKE_UDP
	bool "Bounded redundant UDP PCM for LAN ASR (candidate)"
	default n
	depends on CONTEST2026_441_WAKE_ASR && NET_UDP
	help
		Reuse NuttX datagram sockets and mbedTLS HMAC-SHA256. One current
		and one previous 20ms frame per packet avoid TCP head-of-line stalls.
		Authenticated HTTP creates a fresh stream; larger gaps reset ASR.

config CONTEST2026_441_WAKE
	bool "R1 local wake word to the existing Agora session (candidate)"
	default n
	depends on CONTEST2026_441_AGORA && CONTEST2026_441_POWER && BK7258_AUD
	depends on CONTEST2026_441_WAKE_ASR || (HAVE_CXX && !LIBCXXNONE)
	help
		Explicit agora wake-start/wake-stop/wake-status commands. Uses locked
		OpenVela microfrontend/TFLM inputs and a separately pinned candidate
		model. No automatic listening on boot. Stop microphone and release
		camera ownership before starting the existing voice conversation.
		Requires real human speech, latency, memory and false-wake validation.

config CONTEST2026_441_VISION_BADGE_CAMERA_DEVPATH
	string "V4L2 camera device path"
	default "/dev/video0"

config CONTEST2026_441_VISION_BADGE_AUDIO_DEVPATH
	string "PCM capture device path"
	default "/dev/audio/pcm0c"

config CONTEST2026_441_VISION_BADGE_JPEG_BUFFER_SIZE
	int "Maximum JPEG buffer size"
	default 262144
	range 65536 1048576

config CONTEST2026_441_VISION_BADGE_RESULT_BUFFER_SIZE
	int "Maximum structured result buffer size"
	default 32768
	range 4096 65536

config CONTEST2026_441_VISION_BADGE_MIMO_API_KEY_PATH
	string "MiMo API key file"
	default "/mnt/sdnand/prov/mimo_api_key"
	help
		Plain-text MiMo API key. The application also accepts the existing
		VSWP provisioning records at prov/wifi.bin and prov/vela.cfg. The key
		is read at request time and is never compiled in.

config CONTEST2026_441_VISION_BADGE_MIMO_STORAGE_DEVICE
	string "MiMo credential storage block device"
	default "/dev/mmcsd0"
	help
		Removable block device used when the SD-NAND mount point is not already
		mounted. The application tries the partition node first when present.

endif

config LVX_USE_DEMO_CONTEST2026_441_VISION_BADGE_CLIENT
	bool "Contest 2026 team 441 vision badge CP command"
	default n
	depends on BK7258_RPTUN && !BK7258_AP_CORE && SYSTEM_NSH
	select BUILTIN
	select NSH_BUILTIN_APPS
	help
		Expose the vision_badge command on the CPU0 NSH. Requests are sent to
		the AP camera and MiMo service over a bounded RPMsg endpoint.

config CONTEST2026_441_POWER
	bool "R1 product power coordination (candidate)"
	default n
	depends on BK7258_PM_SOFT_OFF
	depends on !BK7258_AP_CORE || BK7258_AIDK_DUAL_LCD
	depends on LVX_USE_DEMO_CONTEST2026_441_VISION_BADGE || LVX_USE_DEMO_CONTEST2026_441_VISION_BADGE_CLIENT
	depends on !BK7258_AP_CORE || CONTEST2026_441_AGORA
	help
		Explicit quiet/resume/prepare/off commands. Stop new work, drain Agora,
		pause camera, blank panels through their owner, sync, then request CP
		reboot-to-sleep. No automatic battery cutoff or inactivity shutdown.
		CP KEY2 held for 3 seconds requests a power toggle; side keys adjust
		ten output levels. Board validation is
		required; acceptance is not proof of sleep, power removal or wake.

config CONTEST2026_441_PRODUCT_STARTUP
	bool "Opt-in R1 product startup after network readiness"
	default n
	depends on CONTEST2026_441_AGORA && CONTEST2026_441_POWER && CONTEST2026_441_WAKE_ASR
	---help---
		After the existing network warmup succeeds, select the warm-camera
		voice path and arm the configured LAN-assisted wake service. Does not
		start an RTC conversation on boot; detection or the middle key still
		starts it. A separately running LAN ASR/voice host is required. Failure
		is reported without retrying cloud starts or replacing the provider.

config LVX_USE_DEMO_CONTEST2026_441_R1_KEYLED
	bool "Contest 2026 team 441 R1 key/LED test"
	default n
	depends on ARCH_BUTTONS && ARCH_HAVE_LEDS
	---help---
		Enable the r1keyled NSH command used to verify the R1 button and LED
		GPIO mapping by polling.  It is a bring-up diagnostic, not a permanent
		background service.

if LVX_USE_DEMO_CONTEST2026_441_R1_KEYLED

config CONTEST2026_441_R1_KEYLED_STACKSIZE
	int "R1 key/LED test stack size"
	default 2048

endif
```

## board/bk7258-r1/Kconfig
```kconfig
# BK7258 R1 board configuration

if ARCH_BOARD_CUSTOM

config BK7258_R1
	bool
	default y
	select ARCH_HAVE_BUTTONS
	select ARCH_HAVE_LEDS
	help
		Internal marker for the Agora/Beken R1 development kit.

endif
```

## board/bk7258-r1/configs/contest2026_441_vision_badge/defconfig
```kconfig
# CONFIG_NSH_DISABLE_DATE is not set
# CONFIG_NSH_DISABLE_MB is not set
# CONFIG_NSH_DISABLE_MH is not set
# CONFIG_NSH_DISABLE_MW is not set
CONFIG_ARCH="arm"
CONFIG_ARCH_BOARD_CUSTOM=y
CONFIG_ARCH_BOARD_CUSTOM_DIR="../vendor/beken/boards/bk7258/bk7258-r1"
CONFIG_ARCH_BOARD_CUSTOM_DIR_RELPATH=y
CONFIG_ARCH_BOARD_CUSTOM_NAME="bk7258-r1"
CONFIG_ARCH_CHIP="bk7258"
CONFIG_ARCH_CHIP_BK7258=y
CONFIG_ARCH_STACKDUMP=y
CONFIG_BOARD_LATE_INITIALIZE=y
CONFIG_BOARD_LOOPSPERMSEC=60000
CONFIG_BUILTIN=y
CONFIG_DEBUG_SYMBOLS=y
CONFIG_EXPERIMENTAL=y
CONFIG_FS_PROCFS=y
CONFIG_IDLETHREAD_STACKSIZE=2048
CONFIG_INIT_ENTRYPOINT="nsh_main"
CONFIG_INTELHEX_BINARY=y
CONFIG_LIBC_PERROR_STDOUT=y
CONFIG_LVX_USE_DEMO_CONTEST2026_441_VISION_BADGE=y
CONFIG_CONTEST2026_441_VISION_BADGE_STACKSIZE=8192
CONFIG_CONTEST2026_441_VISION_BADGE_CAMERA_DEVPATH="/dev/video0"
CONFIG_CONTEST2026_441_VISION_BADGE_AUDIO_DEVPATH="/dev/audio/pcm0c"
CONFIG_CONTEST2026_441_VISION_BADGE_JPEG_BUFFER_SIZE=262144
CONFIG_CONTEST2026_441_VISION_BADGE_RESULT_BUFFER_SIZE=32768
CONFIG_NSH_BUILTIN_APPS=y
CONFIG_NSH_READLINE=y
CONFIG_PREALLOC_TIMERS=4
CONFIG_RAMLOG=y
CONFIG_RAMLOG_BUFSIZE=8192
CONFIG_RAMLOG_SYSLOG=y
CONFIG_RAM_SIZE=344064
CONFIG_RAM_START=0x28010000
CONFIG_RAW_BINARY=y
CONFIG_RR_INTERVAL=200
CONFIG_SCHED_WAITPID=y
CONFIG_STANDARD_SERIAL=y
CONFIG_START_DAY=27
CONFIG_START_YEAR=2013
CONFIG_SYSTEM_NSH=y
CONFIG_SYSLOG_DEFAULT=y
CONFIG_SYSLOG_DEVPATH="/dev/kmsg"
CONFIG_SYSLOG_MAX_CHANNELS=2
CONFIG_TASK_NAME_SIZE=16
```
